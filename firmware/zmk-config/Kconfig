## firmware/zmk-config/Kconfig
```kconfig
config ZMK_BEHAVIOR_DOUBLE_TAP
    bool
    default y
    depends on DT_HAS_ZMK_BEHAVIOR_DOUBLE_TAP_ENABLED

config KEYFORM_LAYER_REPORT
    bool "Report the active layer to the Keyform notifier"
    default y
```

## firmware/zmk-config/dts/bindings/behaviors/zmk,behavior-double-tap.yaml
```yaml
description: |
  Double tap with the keys as parameters, so they can be chosen per key (e.g. in ZMK Studio).
  &dbl TAP_KEY DOUBLE_TAP_KEY

compatible: "zmk,behavior-double-tap"

include: two_param.yaml

properties:
  tapping-term-ms:
    type: int
    default: 200
```

## firmware/zmk-config/dts/bindings/behaviors/zmk,behavior-game-mod-tap.yaml
```yaml
description: |
  Game Mod-Tap: mod-tap whose settings (hold key, tap length, hold delay, hold rule, instant hold,
  repeat window) are packed into the first parameter, so they can be set per key from Keyform.
  The tap key is held for "tap length" ms so games that check keys once per frame see it.
  &gmt SETTINGS TAP_KEY

compatible: "zmk,behavior-game-mod-tap"

include: two_param.yaml
```
